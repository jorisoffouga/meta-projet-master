## conf/distro/poky-connect.conf
```bitbake
require conf/distro/poky.conf


# Define name of distribution
DISTRO = "poky-connect"
DISTRO_NAME = "Poky Connect powered by Yocto/OE"
DISTROOVERRIDES = "poky:connect"

# SDK settings
SDK_VENDOR = "-connectsdk"
SDK_VERSION := "${@'${DISTRO_VERSION}'.replace('snapshot-${DATE}','snapshot')}"

# Use systemd as init system
VIRTUAL-RUNTIME_init_manager = "systemd"
DISTRO_FEATURES_BACKFILL_CONSIDERED = "sysvinit"
VIRTUAL-RUNTIME_initscripts = ""
DISTRO_FEATURES_append = " systemd"

DISTRO_FEATURES_append = " wifi"

DISTRO_FEATURES_remove = " \
	wayland \
	irda \
	ppp \
	alsa \
	pcmcia \
	smbfs \
	pci \
	3g \
	nfc\
	opengl \
	x11 \
"

# This really saves a lot of disk space!
INHERIT += "rm_work"

#save 300 mb
IMAGE_ROOTFS_EXTRA_SPACE = "300000"

# RPI Settings
RPI_USE_U_BOOT = "1"
ENABLE_UART = "1"
ENABLE_I2C = "1"
ENABLE_SPI_BUS = "1"
DISABLE_VC4GRAPHICS = "1"
MACHINE_FEATURES_remove = "vc4graphics"

# Enable cxx bindings for libgpiod
PACKAGECONFIG_append_pn-libgpiod = " cxx"
```

## conf/layer.conf
```bitbake
# We have a conf and classes directory, add to BBPATH
BBPATH .= ":${LAYERDIR}"

# We have recipes-* directories, add to BBFILES
BBFILES += "${LAYERDIR}/recipes-*/*/*.bb \
            ${LAYERDIR}/recipes-*/*/*.bbappend"

BBFILE_COLLECTIONS += "projet-master"
BBFILE_PATTERN_projet-master = "^${LAYERDIR}/"
BBFILE_PRIORITY_projet-master = "6"

LAYERDEPENDS_projet-master = "core raspberrypi qt5-layer networking-layer meta-python"
LAYERSERIES_COMPAT_projet-master = "warrior"
```
